EXTRN CODE(DELAY)
I2C_SEG SEGMENT CODE
RSEG I2C_SEG


SCL EQU 0A0H.6
SDA EQU 0A0H.7

I2C_ACK:

CLR SCL 
SETB SDA
SETB SCL
JB SDA,$

RET

I2C_NOACK:

CLR SCL
SETB SDA
SETB SCL

RET

I2C_START:
CLR SCL
SETB SDA
SETB SCL
CLR SDA
RET

I2C_STOP:
CLR SCL
CLR SDA
SETB SCL
SETB SDA

RET


/*  =========== WRITE ============   */
I2C_WRITE:

MOV R4,#08H

LAB2:
CLR C
RLC A
CLR SCL
MOV SDA,C
SETB SCL
DJNZ R4,LAB2

RET

/*=================READ==============*/

I2C_READ:

MOV R4,#08H
LAB3:
CLR SCL
SETB SCL
MOV C,SDA
RLC A
DJNZ R4,LAB3

RET

/*================DEVICE READ=============*/
I2C_DEVICE_READ:

CLR A

ACALL I2C_START
MOV A,#0A0H	;WRITE SLAVE ID
ANL A,#0FEH

ACALL I2C_WRITE
ACALL I2C_ACK
MOV A,03H

ACALL I2C_WRITE
ACALL I2C_ACK
ACALL I2C_START
MOV A,#0A0H
ORL A,#01H

ACALL I2C_WRITE
ACALL I2C_ACK
ACALL I2C_READ

MOV @R0,A
XRL A,#0FH
MOV  0B0H,A		;WRITE ONTO PORT
ACALL I2C_NOACK
ACALL I2C_STOP

RET




/*-------------I2C_WRITE----------------*/
I2C_DEVICE_WRITE:

CLR A

ACALL I2C_START
MOV A,#0A0H	;WRITE SLAVE ID
ANL A,#0FEH

ACALL I2C_WRITE
ACALL I2C_ACK
MOV A,R1
 
ACALL I2C_WRITE
ACALL I2C_ACK

CLR A
MOVC A,@A+DPTR

ACALL I2C_WRITE
ACALL I2C_ACK
ACALL I2C_STOP
ACALL DELAY

RET

PUBLIC I2C_DEVICE_READ
PUBLIC I2C_DEVICE_WRITE

END
